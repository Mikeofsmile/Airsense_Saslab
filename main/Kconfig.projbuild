## main/Kconfig.projbuild
```kconfig
menu "Device in use"

    config NAME_DEVICE
        string "Name Device"
        default "AirSENSE_SPARC_LAB"
        help
            Name device.

    config FIRMWARE_VERSION
        string "Firmware version"
        default "1.0.1"
        help
            Firmware version.

    config USING_WIFI
        bool "Using WIFI station"
        default y
        help
            Using connect WIFI.

    config USING_SDCARD
        bool "Using SD card"
        default y
        help
            Using SD card for store data.

    config USING_RTC
        bool "Using RTC module(DS3231)"
        default y
        help
            Using DS3231 module.

    config RTC_TIME_SYNC
        bool "Time synchronization for RTC"
        default y
        help
            Time synchronization for RTC

    config USING_SDS011
        bool "Using SDS011 Sensor"
        default n
        help
            Using SDS011 Sensor.


    config USING_O3_SENSOR
        bool "Using O3 Sensor"
        default n
        help
            Using O3 Sensor.

    config USING_CO_SENSOR
        bool "Using CO Sensor"
        default n
        help
            Using CO Sensor.

    config USING_CO2_SENSOR
        bool "Using CO2 Sensor"
        default n
        help
            Using CO2 Sensor.

    config USING_NO2_SENSOR
        bool "Using NO2 Sensor"
        default n
        help
            Using NO2 Sensor.

endmenu

menu "WiFi Config Menu"

    config SSID
        string  "SSID"
        default "SPARC_LAB"
        help
            SSID.

    config PASSWORD
        string  "PASSWORD"
        default  "123456"
        help
            PASSWORD.

    config MAXIMUM_AP
        int "Maximum access points"
        default  10
        help
            Maximum access points.

    config MAXIMUM_RETRY
        int "Maximum retry"
        default 25
        help
            Set the Maximum retry to avoid station reconnecting to the AP unlimited when the AP is really inexistent.

    config SHOW_LIST_ACCESS_POINTS_FOUND
        bool "Show list Access Points found."
        default y
        help
            Show list Access Points found.

endmenu

menu "MQTT Config menu"

    config BROKER_URI
        string "Broker URL"
        default "mqtt://103.130.212.210:1885"
        help
            URL of an mqtt broker which this device connects to.

    config BROKER_HOST
        string "Broker host"
        default "103.130.212.210"
        help
            Host is MQTT server domain <ipv4 as string>

    config BROKER_PORT
        int "Broker port"
        default 1885
        help
            Port is MQTT server port

    config MQTT_USERNAME
        string "User name"
        default "test"
        help
            MQTT username

    config MQTT_PASSWORD
        string  "Password"
        default  "testadmin"
        help
            MQTT password

    config BROKER_CERTIFICATE_OVERRIDE
        string "Broker certificate override"
        default ""
        help
            Please leave empty if broker certificate included from a textfile; otherwise fill in a base64 part of PEM
            format certificate

    config BROKER_CERTIFICATE_OVERRIDDEN
        bool
        default y if BROKER_CERTIFICATE_OVERRIDE != ""

    config BROKER_BIN_SIZE_TO_SEND
        # This option is not visible and is used only to set parameters for example tests
        # Here we configure the data size to send and to be expected in the python script
        int
        default 20000

endmenu

menu "SD Card menu"

    config PIN_NUM_MOSI
        int "MOSI GPIO Number"
        default 19
        help
            GPIO number for SPI master MOSI.

    config PIN_NUM_MISO
        int "MISO GPIO Number"
        default 21
        help
            GPIO number for SPI master MISO.

    config PIN_NUM_CLK
        int "CLK GPIO Number"
        default 18
        help
            GPIO number for SPI master CLK.

    config PIN_NUM_CS
        int "CS GPIO Number"
        default 5
        help
            GPIO number for SPI master CS.

endmenu

menu "RTC configuration"

    config RTC_PIN_NUM_SCL
        int "SCL GPIO Number"
        default 27 if IDF_TARGET_ESP32 || IDF_TARGET_ESP32S2 || IDF_TARGET_ESP32S3
        help
            GPIO number for I2C Master clock line.

    config RTC_PIN_NUM_SDA
        int "SDA GPIO Number"
        default 26 if IDF_TARGET_ESP32 || IDF_TARGET_ESP32S2 || IDF_TARGET_ESP32S3
        help
            GPIO number for I2C Master data line.

    config RTC_I2C_PORT
        int "I2C Port"
        default 0
        help
            I2C port for RTC module.

    config RTC_I2C_FREQ_HZ
        int "Frequency I2C"
        default 400000
        help
            I2C frequency.

endmenu
```
